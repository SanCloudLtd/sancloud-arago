## build/conf/bblayers.conf
```bitbake
# POKY_BBLAYERS_CONF_VERSION is increased each time build/conf/bblayers.conf
# changes incompatibly
POKY_BBLAYERS_CONF_VERSION = "2"

BBPATH = "${TOPDIR}"
BBFILES ?= ""

BBLAYERS ?= " \
  ${YOCTO_SOURCES}/openembedded-core/meta \
  ${YOCTO_SOURCES}/meta-openembedded/meta-oe \
  ${YOCTO_SOURCES}/meta-openembedded/meta-python \
  ${YOCTO_SOURCES}/meta-openembedded/meta-networking \
  ${YOCTO_SOURCES}/meta-linaro/meta-linaro-toolchain \
  ${YOCTO_SOURCES}/meta-linaro/meta-optee \
  ${YOCTO_SOURCES}/meta-arago/meta-arago-distro \
  ${YOCTO_SOURCES}/meta-arago/meta-arago-extras \
  ${YOCTO_SOURCES}/meta-ti \
  ${YOCTO_SOURCES}/meta-sancloud \
  ${YOCTO_SOURCES}/meta-sancloud/meta-sancloud-arago \
  ${YOCTO_SOURCES}/meta-rtlwifi \
  ${YOCTO_SOURCES}/meta-browser \
  ${YOCTO_SOURCES}/meta-qt5 \
  ${YOCTO_SOURCES}/meta-rust \
  "
```
